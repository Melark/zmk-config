## boards/shields/arrow/Kconfig.defconfig
```kconfig
if SHIELD_SCOTTOCHOCZARD_LEFT

config ZMK_KEYBOARD_NAME
    default "arrow"

config ZMK_SPLIT_ROLE_CENTRAL
    default y

endif

if SHIELD_ARROW_LEFT || SHIELD_ARROW_RIGHT

config ZMK_SPLIT
    default y

endif
```

## boards/shields/arrow/Kconfig.shield
```kconfig
config SHIELD_ARROW_LEFT
    def_bool $(shields_list_contains,arrow_left)

config SHIELD_ARROW_RIGHT
    def_bool $(shields_list_contains,arrow_right)
```
